// SPDX-License-Identifier: GPL-2.0
// Based on LIVI by Lasse Heitgres (https://github.com/f-io/LIVI)
// Modified 2026-10-19: the changes against LIVI are stated below.
/* Derived from LIVI scripts/livi-link/arm/imx6ul/imx6ull-rtl8822cs.dtsi (https://github.com/f-io/LIVI;
 * project GPL-3.0-or-later, upstream SPDX tag GPL-2.0 kept). Realtek RTL8822CS: rtw88 drives Wi-Fi
 * over SDIO, the Bluetooth half speaks H5 on uart3. */
&uart3 {
	bluetooth {
		compatible = "realtek,rtl8822cs-bt";
	};
};
