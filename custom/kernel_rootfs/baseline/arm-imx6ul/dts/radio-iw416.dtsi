// SPDX-License-Identifier: GPL-2.0
// Based on LIVI by Lasse Heitgres (https://github.com/f-io/LIVI)
// Modified 2026-10-19/20: the changes against LIVI are stated below.
/*
 * Derived from LIVI scripts/livi-link/arm/imx6ul/imx6ull-iw416.dtsi (https://github.com/f-io/LIVI;
 * project GPL-3.0-or-later, upstream SPDX tag GPL-2.0 kept). NXP IW416: mwifiex loads the combo
 * firmware over SDIO, btnxpuart only attaches. Change: LIVI's bootargs override
 * (mwifiex.driver_mode=2) is dropped, it would replace panic=10; pass it at load time instead
 * (`MWIFIEX_DRIVER_MODE=2 radio up`). Per mwifiex main.c (7.2.10) driver_mode is a bitmask:
 * 0x1 station (default, mlan0), 0x2 uAP only (uap0), 0x3 uAP + station (corrected 2026-10-20: this
 * comment called 2 "uap0 next to the station"). Only the BT node.
 */
&uart3 {
	bluetooth {
		compatible = "nxp,88w8987-bt";
		fw-init-baudrate = <3000000>;
	};
};
